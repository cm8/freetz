## make/libs/luabit32/Config.in
```kconfig
config FREETZ_LIB_libluabit32
	bool "libluabit32"
	default n
	help
		require('bit32') adds bit manipulation functions to
		the lua interpreter, backport from lua5.2 for lua5.1
```

## make/libs/luaposix/Config.in
```kconfig
config FREETZ_LIB_libluaposix
	bool "libluaposix"
	depends on FREETZ_LIB_libluabit32
	default n
	help
		libluaposix adds posix c-bindings to the lua interpreter
```

## make/libs/luastruct/Config.in
```kconfig
config FREETZ_LIB_libluastruct
	bool "struct.lua"
	default n
	help
		require('struct') imports unpack() / pack() functions
		a lua script uses these to read little- or big-endian
		encoded 16/32/64 bit values, signed or unsigned, from
		a byte string (i.e. a string variable in lua)
```

## make/zimhttpserver/Config.in
```kconfig
comment "zimhttpserver (not available, needs perl and xz (busybox xz or xz-utils))"
	depends on !FREETZ_PACKAGE_PERL || (!FREETZ_BUSYBOX_XZ && !FREETZ_PACKAGE_XZ)

config FREETZ_PACKAGE_ZIMHTTPSERVER
	bool "zimhttpserver"
	default n
	depends on FREETZ_PACKAGE_PERL && (FREETZ_BUSYBOX_XZ || FREETZ_PACKAGE_XZ)
	help
		Port of zimHttpServer.pl to 32-bit architectures with support for 64-bit file
		operations by waynepiekarski. The perl script should work on both, big- and
		little-endian fritz box devices. ZIM files use little-endian format which the
		script accounts for using unpack('V'). This method reads little-endian values
		regardless of the machine-endianess. Depends on a working xz decompressor:

		Busybox xz applet may appear to not work (reports "corrupted data"), _but_
		the error message is misleading. It is a result of an OOM (out of memory)
		error caused by the compression level of the ZIM file. Workarounds:
		- ensure box has physical 128MB RAM (7270 or older devices may not work)
		- add swap space (zram or disk on USB port e. g.)
		- recompress the ZIM file with a lower compression level

		Additional info on serving zim libraries:
		-----------------------------------------

		A more comprehensive solution to serve ZIM files is not available through
		a freetz package yet -afaik-, but can be compiled for mips out-of-freetz.
		  https://github.com/kiwix/kiwix-tools
		  https://github.com/kiwix/kiwix-build/tree/mips32r2
		  https://github.com/kiwix/kiwix-build/blob/mips32r2/kiwixbuild/dependencies/libzim.py

		Expect it to use even more memory than zimhttpserver, although there are non-
		standard configure_options passable to libzim build to lower mem requirements:
		  https://github.com/openzim/libzim/blob/master/meson_options.txt

choice
	depends on FREETZ_PACKAGE_ZIMHTTPSERVER
	prompt "Version"
	default FREETZ_PACKAGE_ZIMHTTPSERVER_VERSION_LATEST_TESTED

	config FREETZ_PACKAGE_ZIMHTTPSERVER_VERSION_LATEST_TESTED
		bool "latest tested"

	config FREETZ_PACKAGE_ZIMHTTPSERVER_VERSION_LATEST_GIT
		bool "latest git revision"
		help
			Note this increases build time by about 2 seconds
			since the latest git-revision is determined anew
			on each make invocation.

endchoice
```

## make/zimrecompress/Config.in
```kconfig
comment "zimrecompress (not available, needs xz (busybox xz or xz-utils))"
	depends on !FREETZ_BUSYBOX_XZ && !FREETZ_PACKAGE_XZ

config FREETZ_PACKAGE_ZIMRECOMPRESS
	bool "zimrecompress"
	default n
	depends on FREETZ_BUSYBOX_XZ || FREETZ_PACKAGE_XZ
	help
		A bash script to recompress ZIM files using a lower compression level.
```

## make/zimsrvlua/Config.in
```kconfig
comment "zimsrvlua (not available, needs xz (busybox xz or xz-utils))"
	depends on !FREETZ_BUSYBOX_XZ && !FREETZ_PACKAGE_XZ

config FREETZ_PACKAGE_ZIMSRVLUA
	bool "zimsrvlua"
	default n
	depends on FREETZ_BUSYBOX_XZ || FREETZ_PACKAGE_XZ
	help
		Rewrite/port of zimHttpServer.pl to the lua script language,
		zimsrvlua can open, index and read blobs from zim files

		arguments are
		(1) zim file to open (if non given <progname>.zim is tried)
		(2) a path into the zim file (articles start with '/A/')

		QUERY_STRING and ZIM_FILE from the OS env precede (1), (2):
		-------------------------------------------------------------

		if QUERY_STRING is properly set by a reverse proxying daemon,
		such as busybox httpd, e.g. with a config line of

		P:/:http://somesrv:7744/cgi-bin/zimsrvlua?/

		then zimsrvlua on somesrv can serve zim content seamlessly to
		a webbrowser client

		zimsrvlua depends on a working xz decompressor:
		-------------------------------------------------------------
		Busybox xz may appear to not work (reports "corrupted data"),
		_but_ the error message is misleading.  It is a result of an
		OOM (out of memory) error caused by the compression level of
		the ZIM file. Workarounds are:
		- ensure box has physical 128MB RAM (7270+older may not work)
		- recompress the ZIM file with a lower compression level
		- add swap space (zram or disk on USB port e.g.)

choice
	depends on FREETZ_PACKAGE_ZIMSRVLUA
	prompt "Linkage"
	default FREETZ_PACKAGE_ZIMSRVLUA_STATIC

	config FREETZ_PACKAGE_ZIMSRVLUA_STATIC
		bool "static, combine interpreter into zimsrvlua at compile time"

	comment "dynamic (not available, needs lua, luaposix, luastruct)"
		depends on !FREETZ_LIB_libluaposix || !FREETZ_LIB_libluastruct

	config FREETZ_PACKAGE_ZIMSRVLUA_DYNAMIC
		bool "dynamic, lua interpreter needed on target system at runtime"
		depends on FREETZ_LIB_libluaposix && FREETZ_LIB_libluastruct
endchoice
```
